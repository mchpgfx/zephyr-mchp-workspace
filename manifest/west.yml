## manifest/west.yml
```yaml
manifest:
  remotes:
    - name: zephyrproject-rtos
      url-base: https://github.com/zephyrproject-rtos

  projects:
    - name: zephyr
      remote: zephyrproject-rtos
      revision: v4.3.0
      import:
        name-allowlist:
          - cmsis
          - cmsis_6
          - hal_atmel
          - hal_microchip
          - picolibc

  self:
    path: manifest
```
